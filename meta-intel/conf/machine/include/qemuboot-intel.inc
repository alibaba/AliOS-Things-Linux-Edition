## meta-intel/conf/machine/include/qemuboot-intel.inc
```bitbake
# For runqemu
IMAGE_CLASSES += "qemuboot"
QB_SYSTEM_NAME_intel-core2-32 = "qemu-system-i386"
QB_CPU_intel-core2-32 = "-cpu coreduo"
QB_CPU_KVM_intel-core2-32 = "-cpu kvm32"

QB_SYSTEM_NAME_intel-corei7-64 = "qemu-system-x86_64"
QB_CPU_intel-corei7-64 = "-cpu Nehalem"
QB_CPU_KVM_intel-corei7-64 = "-cpu kvm64"

QB_SYSTEM_NAME_intel-quark = "qemu-system-i386"
QB_CPU_intel-quark = "-cpu coreduo"
QB_CPU_KVM_intel-quark = "-cpu kvm32"

QB_AUDIO_DRV = "alsa"
QB_AUDIO_OPT = "-soundhw ac97,es1370"
QB_KERNEL_CMDLINE_APPEND = "vga=0 uvesafb.mode_option=640x480-32 oprofile.timer=1 uvesafb.task_timeout=-1"
# Add the 'virtio-rng-pci' device otherwise the guest may run out of entropy
QB_OPT_APPEND = "-vga vmware -show-cursor -usb -usbdevice tablet -device virtio-rng-pci"
```

## meta-intel/conf/machine/intel-core2-32.conf
```bitbake
#@TYPE: Machine
#@NAME: intel-core2-32

#@DESCRIPTION: Machine configuration for 32 bit Intel Core 2 CPU (and later) with MMX, SSE, SSE2, SSE3, and SSSE3 instruction set support. Supports a moderately wide range of drivers that should boot and be usable on "typical" hardware.

require conf/machine/include/meta-intel.inc
require conf/machine/include/intel-core2-32-common.inc
require conf/machine/include/intel-common-pkgarch.inc

MACHINE_FEATURES += "pcbios efi"
MACHINE_FEATURES += "va-impl-intel"
MACHINE_FEATURES += "wifi 3g nfc"
MACHINE_FEATURES += "intel-ucode"

MACHINE_HWCODECS ?= "va-intel gstreamer1.0-vaapi"

MACHINE_ESSENTIAL_EXTRA_RRECOMMENDS += "gma500-gfx-check"

XSERVER ?= "${XSERVER_X86_BASE} \
            ${XSERVER_X86_EXT} \
            ${XSERVER_X86_FBDEV} \
            ${XSERVER_X86_I915} \
            ${XSERVER_X86_I965} \
            ${XSERVER_X86_MODESETTING} \
            ${XSERVER_X86_VESA} \
            ${XSERVER_X86_ASPEED_AST} \
           "

SYSLINUX_OPTS = "serial 0 115200"
SERIAL_CONSOLES = "115200;ttyS0 115200;ttyS1 115200;ttyPCH0"
APPEND += "rootwait console=ttyS0,115200 console=ttyPCH0,115200 console=tty0"

IMAGE_FSTYPES += "wic"
WKS_FILE ?= "${@bb.utils.contains_any("EFI_PROVIDER", "systemd-boot rmc-boot", "systemd-bootdisk.wks", "mkefidisk.wks", d)}"
do_image_wic[depends] += "gptfdisk-native:do_populate_sysroot mtools-native:do_populate_sysroot dosfstools-native:do_populate_sysroot"
```

## meta-intel/conf/machine/intel-quark.conf
```bitbake
#@TYPE: Machine
#@NAME: quark

#@DESCRIPTION: Machine configuration for Quark systems

require conf/machine/include/meta-intel.inc
require conf/machine/include/intel-quark-common.inc
require conf/machine/include/intel-common-pkgarch.inc

#Avoid pulling in GRUB
MACHINE_ESSENTIAL_EXTRA_RDEPENDS = ""

MACHINE_FEATURES = "efi usb"
MACHINE_FEATURES += "intel-ucode"

SERIAL_CONSOLE = "115200 ttyS1"
APPEND += "rootwait console=ttyS1,115200 console=tty0"

# Bypass the default labels which also has "install" option in OE.
#
# We don't need to do this when constructing direct-boot image with
# wic. But EFI installer in hddimg image doesn't work on quark now,
# so we only provide a live-boot entry in boot menu for images in
# hddimg format.

LABELS_LIVE = "boot"

# Ensure that the Lock prefix is omitted for the kernel"
KERNEL_EXTRA_ARGS = "EXTRA_CFLAGS=-Wa,-momit-lock-prefix=yes"

IMAGE_FSTYPES += "wic"
WKS_FILE ?= "galileodisk-sd.wks"
do_image_wic[depends] += "gptfdisk-native:do_populate_sysroot mtools-native:do_populate_sysroot dosfstools-native:do_populate_sysroot"
```

## meta-intel/wic/mktinygalileodisk.wks
```
# short-description: Create an Galileo Gen 1/2 disk image
# long-description: Creates a partitioned EFI disk image for Intel Galileo Gen 1/2,
# that the user can directly dd to boot media.

part /boot --source bootimg-efi --sourceparams="loader=systemd-boot,initrd=core-image-tiny-initramfs-intel-quark.cpio.gz" --ondisk mmcblk0 --label msdos --active --align 1024

bootloader  --timeout=0  --append="console=ttyS1,115200n8 earlycon=uart8250,mmio32,0x9000b000,115200n8 reboot=efi,warm apic=debug rw LABEL=boot debugshell=5"
```

## meta-mont/conf/machine/mips-common.inc
```bitbake
# Include file for parameters common to many MIPS platforms

KERNEL_IMAGETYPE = "vmlinux"
KERNEL_ALT_IMAGETYPE = "vmlinux.bin"

SERIAL_CONSOLES = "115200;ttyS0"

# This disables gobject-introspection which needs fixing for some
# targets. If you need to use that package, remove this line.
MACHINE_FEATURES_BACKFILL_CONSIDERED = "qemu-usermode"

PREFERRED_PROVIDER_virtual/kernel ?= "linux-yocto"
```

## meta-mont/conf/machine/mont-panther.conf
```bitbake
#@TYPE: Machine
#@NAME: mont-panther
#@DESCRIPTION: MIPS 32r2, Little Endian, Soft Float

require conf/machine/include/tune-mips32r2.inc

KERNEL_IMAGETYPE = "uImage"

SERIAL_CONSOLES = "115200;ttyS0"

PREFERRED_PROVIDER_virtual/kernel ?= "linux-yocto"
PREFERRED_VERSION_linux-yocto ?= "4.9%"

IMAGE_FSTYPES_remove = "iso"
IMAGE_FSTYPES += " ext4 mont_image"

DEFAULTTUNE = "mips32r2el-nf"

MACHINE_FEATURES_append = " wifi alsa"

#Classes
IMAGE_CLASSES += "mont_image"

#mips use sysvinit!!
VIRTUAL-RUNTIME_init_manager = "sysvinit"
MACHINE_FEATURES_append = " sysvinit"
MACHINE_FEATURES_BACKFILL_CONSIDERED = "sysvinit"
```

## meta-mont/conf/machine/qemumips32r2.conf
```bitbake
#@TYPE: Machine
#@NAME: qemumips32r2
#@DESCRIPTION: MIPS 32r2, Big Endian, Hard Float

require conf/machine/include/qemu.inc
require conf/machine/include/qemuboot-mips.inc
require conf/machine/include/tune-mips32r2.inc
require mips-common.inc

DEFAULTTUNE = "mips32r2"
```

## meta-mont/conf/machine/qemumips32r6.conf
```bitbake
#@TYPE: Machine
#@NAME: qemumips32r6
#@DESCRIPTION: MIPS 32r6, Big Endian, Hard Float

require conf/machine/include/qemu.inc
require conf/machine/include/qemuboot-mips.inc
require conf/machine/include/tune-mips32r6.inc
require mips-common.inc

DEFAULTTUNE = "mipsisa32r6"

# runqemu extra options
QB_CPU = "-cpu mips32r6-generic"
QB_SYSTEM_NAME = "qemu-system-mips"
```

## meta-mont/conf/machine/qemumips64r6-n32.conf
```bitbake
#@TYPE: Machine
#@NAME: qemumips64r6el-n32
#@DESCRIPTION: MIPS 64r6, Little Endian, Hard Float, N32

require conf/machine/include/qemu.inc
require conf/machine/include/qemuboot-mips.inc
require conf/machine/include/tune-mips64r6.inc
require mips-common.inc

DEFAULTTUNE = "mipsisa64r6-n32"

# runqemu extra options
QB_CPU = "-cpu I6400"
QB_SYSTEM_NAME = "qemu-system-mips64"
```

## meta-mont/conf/machine/qemumips64r6.conf
```bitbake
#@TYPE: Machine
#@NAME: qemumips64r6
#@DESCRIPTION: MIPS 64r6, Big Endian, Hard Float

require conf/machine/include/qemu.inc
require conf/machine/include/qemuboot-mips.inc
require conf/machine/include/tune-mips64r6.inc
require mips-common.inc

DEFAULTTUNE = "mipsisa64r6"

# runqemu extra options
QB_CPU = "-cpu I6400"
QB_SYSTEM_NAME = "qemu-system-mips64"
```

## meta-mont/conf/machine/qemumips64r6el-nf-n32.conf
```bitbake
#@TYPE: Machine
#@NAME: qemumips64r6el-nf-n32
#@DESCRIPTION: MIPS 64r6, Little Endian, Soft Float, N32

require conf/machine/include/qemu.inc
require conf/machine/include/qemuboot-mips.inc
require conf/machine/include/tune-mips64r6.inc
require mips-common.inc

DEFAULTTUNE = "mipsisa64r6el-nf-n32"

# runqemu extra options
QB_CPU = "-cpu I6400"
QB_SYSTEM_NAME = "qemu-system-mips64el"
```

## meta-rockchip/conf/layer.conf
```bitbake
# We have a conf and classes directory, add to BBPATH
BBPATH .= ":${LAYERDIR}:${LAYERDIR}/common"

# We have recipes-* directories, add to BBFILES
BBFILES += "${LAYERDIR}/common/recipes-*/*/*.bb \
            ${LAYERDIR}/common/recipes-*/*/*.bbappend"

BBFILE_COLLECTIONS += "rockchip"
BBFILE_PATTERN_rockchip := "^${LAYERDIR}/common/"
BBFILE_PRIORITY_rockchip = "5"

# Additional license directories.
RK_LICENSE_PATH = "${LAYERDIR}/files/custom-licenses"
RK_BINARY_LICENSE = "${RK_LICENSE_PATH}/LICENSE.rockchip"
LICENSE_PATH += "${RK_LICENSE_PATH}"

LAYERDEPENDS_rockchip = "core"

# This should only be incremented on significant changes that will
# cause compatibility issues with other layers
LAYERVERSION_rockchip = "5"
LAYERSERIES_COMPAT_rockchip = "rocko"

RK_OVERLAY_DIR = "${LAYERDIR}/board/"
```

## meta-rockchip/conf/machine/rockchip-rk3308-evb.conf
```bitbake
# Copyright (c) 2018, Fuzhou Rockchip Electronics Co., Ltd
# Released under the MIT license (see COPYING.MIT for the terms)

#@TYPE: Machine
#@NAME: RK3308 EVB

require conf/machine/include/rk3308.inc

KBUILD_DEFCONFIG = "rk3308_linux_defconfig"
KERNEL_DEVICETREE = "rockchip/rk3308-evb-dmic-pdm-v11.dtb"

UBOOT_MACHINE = "evb-rk3308_defconfig"
```

## meta-rockchip/conf/machine/rockchip-rk3308-voice-module-aarch32.conf
```bitbake
# Copyright (c) 2018, Fuzhou Rockchip Electronics Co., Ltd
# Released under the MIT license (see COPYING.MIT for the terms)

#@TYPE: Machine
#@NAME: RK3308 Voice Module aarch32

require conf/machine/rockchip-rk3308-evb-aarch32.conf

KERNEL_DEVICETREE = "rk3308-voice-module-amic-mainboard-v10-aarch32.dtb"
```

## meta-rockchip/conf/machine/rockchip-rk3326-evb.conf
```bitbake
# Copyright (c) 2018, Fuzhou Rockchip Electronics Co., Ltd
# Released under the MIT license (see COPYING.MIT for the terms)

#@TYPE: Machine
#@NAME: RK3326 EVB

require conf/machine/include/rk3326.inc

KERNEL_DEVICETREE = "rockchip/rk3326-evb-linux-lp3-v10.dtb"

UBOOT_MACHINE = "evb-rk3326_defconfig"
```

## meta-rockchip/wic/generic-gptdisk.wks
```
# short-description: Create a GPT disk image
# long-description: Creates a GPT disk image for Rockchip boards

bootloader --ptable gpt

# 32K-512K(idblock/resource)
part --source rawcopy --sourceparams="file=idblock.img" --align 32 --no-table
part --source rawcopy --sourceparams="file=resource.img" --label resource

# 512k-8M(kernel)
part --source rawcopy --sourceparams="file=kernel.img" --align 512 --label kernel

# 8M-12M(u-boot)
part --source rawcopy --sourceparams="file=u-boot-rk.img" --label u-boot --align 8192 --size 4

# 12M-16M(trust)
part --source rawcopy --sourceparams="file=trust.img" --label trust --size 4

# 16M-(rootfs)
part / --source rootfs --fstype ext4 --label rootfs --extra-space 0 --uuid ${RK_ROOTDEV_UUID}
```

## meta-rockchip/wic/mender-gptdisk.wks
```
# short-description: Create a GPT disk image
# long-description: Creates a GPT disk image for Rockchip boards

# 0~32K: gpt
bootloader --ptable gpt
# 32K~512K: idblock
part --source rawcopy --sourceparams="file=idblock.img" --align 32 --no-table
# 512K~1M: uboot.env
part --source rawcopy --sourceparams="file=uboot.env" --align 512 --label uboot-env
# 1~2M: uboot
part --source rawcopy --sourceparams="file=u-boot-rk.img" --label uboot --align 1024 --size 1
# 2~3M: trust
part --source rawcopy --sourceparams="file=trust.img" --label trust --size 1
part / --source rootfs --fstype ext4 --label root-a --overhead-factor 1 --extra-space 0 --uuid ${RK_ROOTDEV_UUID}
part / --source rootfs --fstype ext4 --label root-b --overhead-factor 1 --extra-space 0 --uuid ${RK_ROOTDEV_UUID}
part --source rawcopy --sourceparams="file=data.ext4" --fstype ext4 --label data
```

## meta-security/conf/layer.conf
```bitbake
# We have a conf and classes directory, add to BBPATH
BBPATH .= ":${LAYERDIR}"

# We have recipes-* directories, add to BBFILES
BBFILES += "${LAYERDIR}/recipes-*/*.bb \
            ${LAYERDIR}/recipes-*/*/*.bb \
            ${LAYERDIR}/recipes-*/*/*.bbappend"

BBFILE_COLLECTIONS += "tfs"
BBFILE_PATTERN_tfs  = "^${LAYERDIR}/"
BBFILE_PRIORITY_tfs = "9"
```

## meta-security/meta-apparmor/conf/layer.conf
```bitbake
# We have a conf and classes directory, add to BBPATH
BBPATH .= ":${LAYERDIR}"

# We have recipes-* directories, add to BBFILES
BBFILES += "${LAYERDIR}/recipes-*/*/*.bb \
    ${LAYERDIR}/recipes-*/*/*.bbappend"

BBFILE_COLLECTIONS += "apparmor"
BBFILE_PATTERN_apparmor = "^${LAYERDIR}/"
BBFILE_PRIORITY_apparmor = "6"
```

## meta-security/meta-secure-base/conf/layer.conf
```bitbake
# We have a conf and classes directory, add to BBPATH
BBPATH .= ":${LAYERDIR}"

# We have recipes-* directories, add to BBFILES
BBFILES += "${LAYERDIR}/recipes-*/*/*.bb \
	${LAYERDIR}/recipes-*/*/*.bbappend"

BBFILE_COLLECTIONS += "secure-base"
BBFILE_PATTERN_secure-base = "^${LAYERDIR}/"
BBFILE_PRIORITY_secure-base = "10"

LAYERDEPENDS_secure-base = "\
    core \
"
```

## meta-security/meta-secure-storage/conf/layer.conf
```bitbake
# We have a conf and classes directory, add to BBPATH
BBPATH .= ":${LAYERDIR}"

# We have recipes-* directories, add to BBFILES
BBFILES += "${LAYERDIR}/recipes-*/*.bb \
            ${LAYERDIR}/recipes-*/*/*.bb \
            ${LAYERDIR}/recipes-*/*/*.bbappend"

BBFILE_COLLECTIONS  += "secure-storage"
BBFILE_PATTERN_secure-storage  = "^${LAYERDIR}/"
BBFILE_PRIORITY_secure-storage = "10"
```

## meta-security/meta-tpm2/conf/layer.conf
```bitbake
# We have a conf and classes directory, add to BBPATH
BBPATH .= ":${LAYERDIR}"

# We have recipes-* directories, add to BBFILES
BBFILES += "${LAYERDIR}/recipes-*/*/*.bb \
	${LAYERDIR}/recipes-*/*/*.bbappend"

BBFILE_COLLECTIONS += "tpm2"
BBFILE_PATTERN_tpm2 = "^${LAYERDIR}/"
BBFILE_PRIORITY_tpm2 = "10"

BBLAYERS_LAYERINDEX_NAME_tpm2 = "meta-tpm2"

LAYERDEPENDS_tpm2 = "core"
```

## meta-via/meta-freescale/conf/machine/imx6artigoa820.conf
```bitbake
#@TYPE: Machine
#@NAME: VIA ARTiGO A820
#@SOC: i.MX6Q
#@DESCRIPTION: Machine configuration for VIA ARTiGO A820

MACHINEOVERRIDES =. "mx6:mx6q:mx6dl:"

require conf/machine/include/imx-base.inc
require conf/machine/include/tune-cortexa9.inc

KERNEL_DEVICETREE = "imx6q-artigoa820.dtb imx6dl-artigoa820.dtb imx6qp-artigoa820.dtb"

UBOOT_CONFIG ??= "sd"
UBOOT_CONFIG[sd] = "mx6artigoa820_config,sdcard"

SERIAL_CONSOLE = "115200 ttymxc0"

MACHINE_ESSENTIAL_EXTRA_RDEPENDS += "ax88772"

MACHINE_FIRMWARE += " linux-firmware-ath6k linux-firmware-ath9k linux-firmware-ar3k"

MACHINE_FEATURES += " pci wifi bluetooth"

IMAGE_CLASSES += "image_types_via"

IMAGE_FSTYPES += "tar.gz"

SERIAL_CONSOLE = "115200 ttymxc1"

WIC_CREATE_EXTRA_ARGS_append = " --no-fstab-update"
```

## meta-via/meta-via-arm/conf/distro/AliOS-via.conf
```bitbake
require conf/distro/include/AliOS-via.inc

# Systemd please
DISTRO_FEATURES_append = " systemd"
VIRTUAL-RUNTIME_init_manager = "systemd"
DISTRO_FEATURES_BACKFILL_CONSIDERED = "sysvinit"

# kernel base
LINUXLIBCVERSION = "4.9%"

# GCC toolchain
GCCVERSION = "6.3%"
GLIBCVERSION = "2.24%"
```
