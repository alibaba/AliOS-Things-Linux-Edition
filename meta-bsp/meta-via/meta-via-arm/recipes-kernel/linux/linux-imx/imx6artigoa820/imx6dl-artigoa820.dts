/*
 * Copyright 2014-2018 VIA Technologies, Inc.
 * Copyright (C) 2013-2015 Freescale Semiconductor, Inc.
 *
 * This program is free software; you can redistribute it and/or modify
 * it under the terms of the GNU General Public License version 2 as
 * published by the Free Software Foundation.
 */

/dts-v1/;

#include "imx6dl.dtsi"
#include "imx6qdl-artigoa820.dtsi"

/ {
	model = "VIA i.MX6 DualLite ARTiGO A820 Board";
	compatible = "via,imx6dl-artigoa820", "fsl,imx6dl";
};
