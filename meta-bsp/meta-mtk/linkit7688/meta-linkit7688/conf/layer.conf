## meta-bsp/meta-mtk/linkit7688/meta-linkit7688/conf/layer.conf
```bitbake
# We have a conf and classes directory, add to BBPATH
BBPATH .= ":${LAYERDIR}"

# We have a recipes-* directories, add to BBFILES
BBFILES += "${LAYERDIR}/recipes-*/*/*.bb \
	${LAYERDIR}/recipes-*/*/*.bbappend"

BBFILE_COLLECTIONS += "linkit7688"
BBFILE_PATTERN_linkit7688 = "^${LAYERDIR}/"
BBFILE_PRIORITY_linkit7688 = "6"
```

## meta-bsp/meta-mtk/linkit7688/meta-linkit7688/conf/machine/linkit7688.conf
```bitbake
#@TYPE: Machine
#@NAME: linkit7688

#@DESCRIPTION: Machine configuration for linkit7688 systems

require conf/machine/include/mips/tune-mips-24k.inc
DEFAULTTUNE = "mips32r2-24kec"

MACHINE_FEATURES = "usbhost serial wifi"

KERNEL_IMAGETYPE = "vmlinux"
KERNEL_ALT_IMAGETYPE = "vmlinux.bin"
KERNEL_IMAGE_STRIP_EXTRA_SECTIONS  = ".comment"


PREFERRED_PROVIDER_virtual/kernel ?= "linux-yocto"
PREFERRED_VERSION_linux-yocto ?= "4.9%"

SERIAL_CONSOLES = "57600;ttyS2"
USE_VT ?= "0"

MACHINE_EXTRA_RRECOMMENDS = " kernel-modules"

IMAGE_FSTYPES ?= "jffs2 tar.bz2"
JFFS2_ERASEBLOCK = "0x10000"

MACHINE_ESSENTIAL_EXTRA_RRECOMMENDS += "\
kernel-module-backports \
kernel-module-mt76 \
kernel-module-mt7603e \
kernel-module-mt76x2e \
"

RDEPENDS_kernel-base = ""

# Little Endian
TUNE_FEATURES_tune-mips-nf = "o32"
```

## meta-bsp/meta-mtk/linkit7688/meta-micro-iot/conf/distro/micro-iot.conf
```bitbake
require conf/distro/poky-tiny.conf

DISTRO_NAME = "micro-iot"
DISTRO_VERSION = "0.1"
DISTRO_FEATURES = "usbhost wifi"
# DISTRO_EXTRA_RDEPENDS = ""
# DISTRO_EXTRA_RRECOMMENDS = ""
TCLIBC = "musl"

DISTRO_FEATURES += "wifi"
```

## meta-bsp/meta-mtk/linkit7688/meta-micro-iot/conf/layer.conf
```bitbake
# We have a conf and classes directory, add to BBPATH
BBPATH .= ":${LAYERDIR}"

# We have recipes-* directories, add to BBFILES
BBFILES += "${LAYERDIR}/recipes-*/*/*.bb \\
            ${LAYERDIR}/recipes-*/*/*.bbappend"

BBFILE_COLLECTIONS += "micro-iot"
BBFILE_PATTERN_micro-iot = "^${LAYERDIR}/"
BBFILE_PRIORITY_micro-iot = "6"
```

## meta-bsp/meta-rockchip/conf/machine/include/rk3308.inc
```bitbake
# Copyright (c) 2018, Fuzhou Rockchip Electronics Co., Ltd
# Released under the MIT license (see COPYING.MIT for the terms)

SOC_FAMILY = "rk3308"
require conf/machine/include/rockchip-arm64-common.inc
```

## meta-bsp/meta-rockchip/conf/machine/include/rockchip-arm64-common.inc
```bitbake
# Copyright (c) 2018, Fuzhou Rockchip Electronics Co., Ltd
# Released under the MIT license (see COPYING.MIT for the terms)

DEFAULTTUNE ?= "aarch64"
require conf/machine/include/rockchip-common.inc
require conf/machine/include/arm/arch-armv8.inc

SERIAL_CONSOLES = "1500000;ttyFIQ0"

RK_TRUST_INI ?= "${@d.getVar('SOC_FAMILY').upper() + 'TRUST.ini'}"
```

## meta-bsp/meta-rockchip/conf/machine/include/rockchip-common.inc
```bitbake
# Copyright (c) 2018, Fuzhou Rockchip Electronics Co., Ltd
# Released under the MIT license (see COPYING.MIT for the terms)

require conf/machine/include/soc-family.inc

MACHINE_EXTRA_RRECOMMENDS_append = " kernel-modules linux-firmware"

SERIAL_CONSOLES ?= "115200;ttyFIQ0"
KERNEL_IMAGETYPE ?= "Image"
KBUILD_DEFCONFIG ?= "rockchip_linux_defconfig"

PREFERRED_PROVIDER_virtual/bootloader ?= "u-boot-rockchip"
PREFERRED_PROVIDER_u-boot ?= "u-boot-rockchip"

IMAGE_FSTYPES += "ext4"
IMAGE_FSTYPES_remove = "iso live"

RK_MINILOADER_INI ?= "${@d.getVar('SOC_FAMILY').upper() + 'MINIALL.ini'}"

IMAGE_FSTYPES += "wic"
WKS_FILE ?= "${@bb.utils.contains('DISTRO_FEATURES', 'uota', 'mender-gptdisk.wks', 'generic-gptdisk.wks', d)}"
do_image_wic[depends] += " \
        virtual/kernel:do_deploy \
        virtual/bootloader:do_deploy \
        rk-binary-loader:do_deploy \
"
export RK_ROOTDEV_UUID ?= "614e0000-0000-4b53-8000-1d28000054a9"

POST_ROOTFS_SCRIPT ?= "${RK_OVERLAY_DIR}/${MACHINE}/post_rootfs.sh"

ROOTFS_POSTPROCESS_COMMAND += "do_post_rootfs;"
do_post_rootfs() {
	if [ ! -f "${POST_ROOTFS_SCRIPT}" ];then
		echo "${POST_ROOTFS_SCRIPT} not found."
		return
	fi

	echo "Running ${POST_ROOTFS_SCRIPT}..."

	cd ${POST_ROOTFS_SCRIPT}/../
	./post_rootfs.sh ${IMAGE_ROOTFS}
}

# Pack data.tar & data/ to data.ext4
ROOTFS_POSTPROCESS_COMMAND += "${@bb.utils.contains('DISTRO_FEATURES', 'uota', 'gen_data;', '', d)}"
gen_data() {
	cd "${DEPLOY_DIR_IMAGE}"
	mkdir -p data

	[ -f data.tar ] && tar xf data.tar

	dd if=/dev/null of=data.ext4 bs=${RK_DATA_SIZE}K count=0 seek=1
	mke2fs -F data.ext4 -d data -L data
}

IMAGE_POSTPROCESS_COMMAND += "gen_rkparameter;"
gen_rkparameter() {
	IMAGE="${IMGDEPLOYDIR}/${IMAGE_NAME}${IMAGE_NAME_SUFFIX}.wic"
	if [ ! -f "${IMAGE}" ];then
		echo "${IMAGE} not found."
		return
	fi

	OUT="${IMGDEPLOYDIR}/parameter"

	echo "Generating ${OUT}..."

	echo "# IMAGE_NAME: ${IMAGE_NAME}" > ${OUT}
	echo "FIRMWARE_VER: 1.0" >> ${OUT}
	echo "TYPE: GPT" >> ${OUT}
	echo -n "CMDLINE: mtdparts=rk29xxnand:" >> ${OUT}
	sgdisk -p ${IMAGE} |grep -E "^ +[0-9]" |while read line;do
		NAME=$(echo ${line}|cut -f 7 -d ' ')
		START=$(echo ${line}|cut -f 2 -d ' ')
		END=$(echo ${line}|cut -f 3 -d ' ')
		SIZE=$(expr ${END} - ${START} + 1)
		printf "0x%08x@0x%08x(%s)," ${SIZE} ${START} ${NAME} >> ${OUT}
	done
	echo "\nuuid: rootfs=${RK_ROOTDEV_UUID}" >> ${OUT}
}

IMAGE_POSTPROCESS_COMMAND += "gen_rkupdateimg;"
gen_rkupdateimg() {
	IMAGE="${IMGDEPLOYDIR}/${IMAGE_NAME}${IMAGE_NAME_SUFFIX}.wic"
	if [ ! -f "${IMAGE}" ];then
		echo "${IMAGE} not found."
		return
	fi

	cd ${IMGDEPLOYDIR}

	RK_IMAGES="loader.bin uboot.env u-boot-rk.img trust.img kernel.img \
			resource.img data.ext4"

	# Create temporary symlinks, because the tool would crash with abs pathes
	for img in ${RK_IMAGES};do
		f=${DEPLOY_DIR_IMAGE}/${img}
		[ -f ${f} ] && ln -sf ${f} .
	done

	ln -sf ${IMAGE_NAME}${IMAGE_NAME_SUFFIX}.ext4 rootfs.img

	OUT="${IMGDEPLOYDIR}/package-file"

	echo "Generating ${OUT}..."

	echo "# IMAGE_NAME: ${IMAGE_NAME}" > ${OUT}
	echo "package-file package-file" >> ${OUT}
	echo "bootloader loader.bin" >> ${OUT}
	echo "parameter parameter" >> ${OUT}
	sgdisk -p ${IMAGE} |grep -E "^ +[0-9]" |while read line;do
		NAME=$(echo ${line}|cut -f 7 -d ' ')

		echo -n "${NAME} " >> ${OUT}
		case "${NAME}" in
			uboot-env)
				echo "uboot.env" >> ${OUT}
				;;
			uboot)
				echo "u-boot-rk.img" >> ${OUT}
				;;
			trust|kernel|resource)
				echo "${NAME}.img" >> ${OUT}
				;;
			root*)
				echo "rootfs.img" >> ${OUT}
				;;
			data)
				echo "data.ext4" >> ${OUT}
				;;
		esac
	done

	afptool -pack ./ update.raw.img
	rkImageMaker -${SOC_FAMILY} loader.bin update.raw.img update.img -os_type:androidos

	rm -rf ${RK_IMAGES} update.raw.img
}

# Fixup rootfs size to 240M
RK_ROOTFS_SIZE ?= "245760"
IMAGE_ROOTFS_ALIGNMENT = "${RK_ROOTFS_SIZE}"
IMAGE_ROOTFS_MAXSIZE = "${RK_ROOTFS_SIZE}"
IMAGE_ROOTFS_SIZE = "8192"
IMAGE_OVERHEAD_FACTOR = "1"
```

## meta-bsp/meta-rockchip/conf/machine/rockchip-rk3308-smart-voice-a1-aarch32.conf
```bitbake
# Copyright (c) 2018, Fuzhou Rockchip Electronics Co., Ltd
# Released under the MIT license (see COPYING.MIT for the terms)

#@TYPE: Machine
#@NAME: RK3308 Smart Voice A1 aarch32

require conf/machine/rockchip-rk3308-evb-aarch32.conf

KERNEL_DEVICETREE = "rk3308-smart-voice-a1-aarch32.dtb"
```

## meta-bsp/meta-rockchip/wic/generic-gptdisk.wks
```
# short-description: Create a GPT disk image
# long-description: Creates a GPT disk image for Rockchip boards

# 0~32K: gpt
bootloader --ptable gpt
# 32K~1M: idblock
part --source rawcopy --sourceparams="file=idblock.img" --align 32 --no-table
# 1~2M: uboot
part --source rawcopy --sourceparams="file=u-boot-rk.img" --label uboot --align 1024 --size 1
# 2~3M: trust
part --source rawcopy --sourceparams="file=trust.img" --label trust --size 1
# 3-4M: resource
part --source rawcopy --sourceparams="file=resource.img" --label resource --size 1
# 4~12M: kernel
part --source rawcopy --sourceparams="file=kernel.img" --label kernel --size 8
# 12M+: rootfs
part / --source rootfs --fstype ext4 --label rootfs --overhead-factor 1 --extra-space 0 --uuid ${RK_ROOTDEV_UUID}
```

## meta-bsp/meta-via/meta-via-arm/conf/distro/alios-via.conf
```bitbake
require conf/distro/include/alios-via.inc

# Systemd please
DISTRO_FEATURES_append = " systemd"
VIRTUAL-RUNTIME_init_manager = "systemd"
DISTRO_FEATURES_BACKFILL_CONSIDERED = "sysvinit"

# kernel base
LINUXLIBCVERSION = "4.9%"

# GCC toolchain
GCCVERSION = "6.3%"
GLIBCVERSION = "2.24%"
```

## meta-core/meta-base/conf/distro/include/tclibc-bionic.inc
```bitbake
#
# bionic specific configuration
# NOTICE: When using bionic as the standard C library, you should put meta-core/meta-base
# before meta-yp/meta in BBLAYERS to override bbclasses
# For now, bionic supports alios-tiny on qemux86-64, qemuarm64 and raspberrypi3-64

LIBCEXTENSION = "-android"

# Add bionic libc overrides to the overrides.
LIBCOVERRIDE = ":libc-bionic"
OVERRIDES .= "${LIBCOVERRIDE}"

PREFERRED_PROVIDER_virtual/libc ?= "bionic"
PREFERRED_PROVIDER_virtual/libintl ?= "gettext"
PREFERRED_PROVIDER_virtual/libiconv ?= "mini-iconv"

# Currently, bionic need to use its own linux headers.
PREFERRED_PROVIDER_linux-libc-headers = "bionic-linux-libc-headers"

PREFERRED_PROVIDER_virtual/nativesdk-libintl ?= "nativesdk-glibc"
PREFERRED_PROVIDER_virtual/nativesdk-libiconv ?= "nativesdk-glibc"

PACKAGE_INSTALL_append +=  "bionic-linker"
DISTRO_FEATURES_append += "ld-is-gold"

IMAGE_LINGUAS = ""

LIBC_DEPENDENCIES = "\
    bionic \
    bionic-dbg \
    bionic-dev \
    "
```

## meta-core/meta-security/meta-accounts/conf/layer.conf
```bitbake
# We have a conf and classes directory, add to BBPATH
BBPATH .= ":${LAYERDIR}"

# We have recipes-* directories, add to BBFILES
BBFILES += "${LAYERDIR}/recipes-*/*.bb \
            ${LAYERDIR}/recipes-*/*/*.bb \
            ${LAYERDIR}/recipes-*/*/*.bbappend"

BBFILE_COLLECTIONS += "accounts"
BBFILE_PATTERN_accounts = "^${LAYERDIR}/"
BBFILE_PRIORITY_accounts = "6"
```

## meta-core/meta-security/meta-efi-secure-boot/conf/layer.conf
```bitbake
# We have a conf and classes directory, add to BBPATH
BBPATH .= ":${LAYERDIR}"

# We have recipes-* directories, add to BBFILES
BBFILES += "${LAYERDIR}/recipes-*/*/*.bb \
	${LAYERDIR}/recipes-*/*/*.bbappend"

BBFILE_COLLECTIONS += "efi-secure-boot"
BBFILE_PATTERN_efi-secure-boot = "^${LAYERDIR}/"
BBFILE_PRIORITY_efi-secure-boot = "10"

BBLAYERS_LAYERINDEX_NAME_efi-secure-boot = "meta-efi-secure-boot"

LAYERDEPENDS_efi-secure-boot = "\
    core \
    openembedded-layer \
    signing-key \
    perl-layer \
"
```

## meta-core/meta-security/meta-encrypted-storage/conf/layer.conf
```bitbake
# We have a conf and classes directory, add to BBPATH
BBPATH .= ":${LAYERDIR}"

# We have recipes-* directories, add to BBFILES
BBFILES += "${LAYERDIR}/recipes-*/*/*.bb \
	${LAYERDIR}/recipes-*/*/*.bbappend"

BBFILE_COLLECTIONS += "encrypted-storage"
BBFILE_PATTERN_encrypted-storage = "^${LAYERDIR}/"
BBFILE_PRIORITY_encrypted-storage = "10"

BBLAYERS_LAYERINDEX_NAME_encrypted-storage = "meta-encrypted-storage"

LAYERDEPENDS_encrypted-storage = "\
    core \
    tpm2 \
    openembedded-layer \
"
```

## meta-core/meta-security/meta-integrity/conf/layer.conf
```bitbake
# We have a conf and classes directory, add to BBPATH
BBPATH .= ":${LAYERDIR}"

# We have recipes-* directories, add to BBFILES
BBFILES += "${LAYERDIR}/recipes-*/*/*.bb \
	${LAYERDIR}/recipes-*/*/*.bbappend"

BBFILE_COLLECTIONS += "integrity"
BBFILE_PATTERN_integrity = "^${LAYERDIR}/"
BBFILE_PRIORITY_integrity = "10"

IMA_SIGNING_BLACKLIST ??= "${LAYERDIR}/files/ima_signing_blacklist"

BBLAYERS_LAYERINDEX_NAME_integrity = "meta-integrity"

LAYERDEPENDS_integrity = "\
    core \
    signing-key \
"

LAYERRECOMMENDS_integrity = "\
    tpm2 \
    tpm \
"

BB_HASHBASE_WHITELIST_append += "\
    RPM_FSK_PATH \
"
```

## meta-core/meta-security/meta-secure-core/meta-ids/conf/layer.conf
```bitbake
# We have a conf and classes directory, add to BBPATH
BBPATH .= ":${LAYERDIR}"

# We have recipes-* directories, add to BBFILES
BBFILES += "${LAYERDIR}/recipes-*/*/*.bb \
	${LAYERDIR}/recipes-*/*/*.bbappend"

BBFILE_COLLECTIONS += "ids"
BBFILE_PATTERN_ids = "^${LAYERDIR}/"
BBFILE_PRIORITY_ids = "10"

BBLAYERS_LAYERINDEX_NAME_ids = "meta-ids"

LAYERDEPENDS_ids = "\
    core \
    networking-layer \
"
```

## meta-core/meta-security/meta-secure-core/meta-tpm/conf/layer.conf
```bitbake
# We have a conf and classes directory, add to BBPATH
BBPATH .= ":${LAYERDIR}"

# We have recipes-* directories, add to BBFILES
BBFILES += "${LAYERDIR}/recipes-*/*/*.bb \
	${LAYERDIR}/recipes-*/*/*.bbappend"

BBFILE_COLLECTIONS += "tpm"
BBFILE_PATTERN_tpm = "^${LAYERDIR}/"
BBFILE_PRIORITY_tpm = "10"

BBLAYERS_LAYERINDEX_NAME_tpm = "meta-tpm"

LAYERDEPENDS_tpm = "core"
```

## meta-core/meta-security/meta-signing-key/conf/layer.conf
```bitbake
# We have a conf and classes directory, add to BBPATH
BBPATH .= ":${LAYERDIR}"

# We have recipes-* directories, add to BBFILES
BBFILES += "${LAYERDIR}/recipes-*/*/*.bb \
	${LAYERDIR}/recipes-*/*/*.bbappend"

BBFILE_COLLECTIONS += "signing-key"
BBFILE_PATTERN_signing-key = "^${LAYERDIR}/"
BBFILE_PRIORITY_signing-key = "10"

BBLAYERS_LAYERINDEX_NAME_signing-key = "meta-signing-key"

LAYERDEPENDS_signing-key = "core"

SIGNING_MODEL ??= "sample"
SAMPLE_MOK_SB_KEYS_DIR = "${LAYERDIR}/files/mok_sb_keys"
SAMPLE_UEFI_SB_KEYS_DIR = "${LAYERDIR}/files/uefi_sb_keys"
SAMPLE_SYSTEM_TRUSTED_KEYS_DIR = "${LAYERDIR}/files/system_trusted_keys"
SAMPLE_EXTRA_SYSTEM_TRUSTED_KEYS_DIR = "${LAYERDIR}/files/extra_system_trusted_keys"
SAMPLE_MODSIGN_KEYS_DIR = "${LAYERDIR}/files/modsign_keys"
SAMPLE_IMA_KEYS_DIR = "${LAYERDIR}/files/ima_keys"
SAMPLE_RPM_KEYS_DIR = "${LAYERDIR}/files/rpm_keys"

# Microsoft certificates
MSFT_DB_CERT = "${LAYERDIR}/files/uefi_sb_keys/ms-DB.crt"
MSFT_KEK_CERT = "${LAYERDIR}/files/uefi_sb_keys/ms-KEK.crt"

# EV certificate
EV_CERT ??= "${LAYERDIR}/files/mok_sb_keys/wosign_ev_cert.crt"

# By default the sample keys are used
MOK_SB_KEYS_DIR ??= "${SAMPLE_MOK_SB_KEYS_DIR}"
UEFI_SB_KEYS_DIR ??= "${SAMPLE_UEFI_SB_KEYS_DIR}"
SYSTEM_TRUSTED_KEYS_DIR ??= "${SAMPLE_SYSTEM_TRUSTED_KEYS_DIR}"
EXTRA_SYSTEM_TRUSTED_KEYS_DIR ??= "${SAMPLE_EXTRA_SYSTEM_TRUSTED_KEYS_DIR}"
MODSIGN_KEYS_DIR ??= "${SAMPLE_MODSIGN_KEYS_DIR}"
IMA_KEYS_DIR ??= "${SAMPLE_IMA_KEYS_DIR}"
RPM_KEYS_DIR ??= "${SAMPLE_RPM_KEYS_DIR}"

# Define the identification of vendor
VENDOR_UUID = "1f7b9654-2107-4697-8f1c-0cbc38874588"

# User configurable identification of signature owner 
UEFI_SIG_OWNER_GUID ??= "${VENDOR_UUID}"

SAMPLE_RPM_KEYNAME ??= "SecureCore"
RPM_GPG_NAME ?= "${SAMPLE_RPM_KEYNAME}"
RPM_GPG_PASSPHRASE ?= "SecureCore"

BB_HASHBASE_WHITELIST_append += "\
    SYSTEM_TRUSTED_KEYS_DIR \
    EXTRA_SYSTEM_TRUSTED_KEYS_DIR \
    MODSIGN_KEYS_DIR \
    IMA_KEYS_DIR \
    RPM_KEYS_DIR \
    UEFI_SB_KEYS_DIR MOK_SB_KEYS_DIR \
    EV_CERT MSFT_DB_CERT MSFT_KEK_CERT \
"
```

## meta-core/meta-security/meta/conf/layer.conf
```bitbake
# We have a conf and classes directory, add to BBPATH
BBPATH .= ":${LAYERDIR}"

# We have recipes-* directories, add to BBFILES
BBFILES += "${LAYERDIR}/recipes-*/*/*.bb \
	${LAYERDIR}/recipes-*/*/*.bbappend"

BBFILE_COLLECTIONS += "secure-core"
BBFILE_PATTERN_secure-core = "^${LAYERDIR}/"
BBFILE_PRIORITY_secure-core = "10"

BBLAYERS_LAYERINDEX_NAME_secure-core = "meta-secure-core"

LAYERDEPENDS_secure-core = "\
    core \
"
```

## meta-core/meta-virtualization/conf/layer.conf
```bitbake
# We have a conf and classes directory, add to BBPATH
BBPATH .= ":${LAYERDIR}"

# We have recipes-* directories, add to BBFILES
BBFILES += "${LAYERDIR}/recipes-*/*.bb \
            ${LAYERDIR}/recipes-*/*/*.bb \
            ${LAYERDIR}/recipes-*/*/*.bbappend"

BBFILE_COLLECTIONS  += "virtualization"
BBFILE_PATTERN_virtualization  = "^${LAYERDIR}/"
BBFILE_PRIORITY_virtualizaiton = "9"
```
