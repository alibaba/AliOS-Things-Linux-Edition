## meta-framework/conf/layer.conf
```bitbake
# We have a conf and classes directory, add to BBPATH
BBPATH .= ":${LAYERDIR}"

# We have recipes-* directories, add to BBFILES
BBFILES += "${LAYERDIR}/recipes-*/*.bb \
            ${LAYERDIR}/recipes-*/*/*.bb \
            ${LAYERDIR}/recipes-*/*/*.bbappend"

BBFILE_COLLECTIONS += "framework"
BBFILE_PATTERN_framework  = "^${LAYERDIR}/"
BBFILE_PRIORITY_framework = "9"

INHERIT += "${@bb.utils.contains('DISTRO_FEATURES', 'uota', 'mender-setup', '', d)}"
BBMASK += "${@bb.utils.contains('DISTRO_FEATURES', 'uota', '', 'u-boot-fw-utils-mender-auto-provided', d)}"
```

## meta-freescale/conf/machine/ls1043ardb.conf
```bitbake
#@TYPE: Machine
#@NAME: NXP LS1043ARDB board
#@SOC: LSCH2
#@DESCRIPTION: Machine configuration for NXP QorIQ LS1043ARDB
#              with ARM Cortext-A53 core
#@MAINTAINER: Ting Liu <ting.liu@nxp.com>

MACHINEOVERRIDES =. "fsl-lsch2:ls1043a:"

require conf/machine/include/qoriq-arm64.inc
require conf/machine/include/arm/arch-arm64.inc

KERNEL_CLASSES  = " kernel-itbimage "
KERNEL_IMAGETYPES = "itbImage"

DTB_LOAD = "0x90000000"
UBOOT_ENTRYPOINT = "0x80080000"

UBOOT_CONFIG ??= "atf atf-sd"
UBOOT_CONFIG[atf] = "ls1043ardb_atf_defconfig,,u-boot-dtb.bin"
UBOOT_CONFIG[atf-sd] = "ls1043ardb_atf_sd_defconfig,,u-boot-dtb.bin"

KERNEL_DEVICETREE ?= "freescale/fsl-ls1043a-rdb-sdk.dtb"
KERNEL_DEFCONFIG ?= "defconfig"

QE_UCODE = "iram_Type_A_LS1021a_r1.0.bin"
EXTRA_IMAGEDEPENDS += "fm-ucode rcw qe-ucode uefi arm-trusted-firmware optee-os-qoriq"
USE_VT = "0"
```

## meta-intel/conf/layer.conf
```bitbake
# We have a conf and classes directory, add to BBPATH
BBPATH .= ":${LAYERDIR}:${LAYERDIR}/common"

# We have recipes-* directories, add to BBFILES
BBFILES += "${LAYERDIR}/common/recipes-*/*/*.bb \
            ${LAYERDIR}/common/recipes-*/*/*.bbappend"

BBFILE_COLLECTIONS += "intel"
BBFILE_PATTERN_intel := "^${LAYERDIR}/common/"
BBFILE_PRIORITY_intel = "5"

# Additional license directories.
LICENSE_PATH += "${LAYERDIR}/common/custom-licenses"

LAYERDEPENDS_intel = "core"
LAYERRECOMMENDS_intel = "dpdk intel-qat"

# This should only be incremented on significant changes that will
# cause compatibility issues with other layers
LAYERVERSION_intel = "5"
LAYERSERIES_COMPAT_intel = "rocko"


require ${LAYERDIR}/conf/include/maintainers.inc
```

## meta-intel/conf/machine/include/meta-intel.inc
```bitbake
#
# BSP variables and settings specific to the meta-intel layer.
# You must include the meta-intel layer in your bblayers.conf
# to use them.
#

#
# XSERVER subcomponents, used to build the XSERVER variable
#

# Soft set linux-yocto as preferred kernel like x86-base.inc
PREFERRED_PROVIDER_virtual/kernel ?= "linux-intel"
PREFERRED_PROVIDER_virtual/kernel_poky-tiny ?= "linux-intel"
PREFERRED_PROVIDER_virtual/kernel_linuxstdbase ?= "linux-yocto"
PREFERRED_VERSION_linux-intel ?= "4.9%"

# for Xserver older than 1.13.0
OLD_XSERVER_X86_EXT = "xserver-xorg-extension-dri \
           xserver-xorg-extension-dri2 \
           xserver-xorg-extension-extmod \
           xserver-xorg-extension-dbe \
           "

XSERVER_X86_MATROX_MGA = "xf86-video-mga \
           "

XSERVER_X86_ASPEED_AST = "xf86-video-ast \
           "

# include the user space intel microcode loading support in the generated images.
MACHINE_ESSENTIAL_EXTRA_RDEPENDS_append = "${@bb.utils.contains('MACHINE_FEATURES', 'intel-ucode', ' intel-microcode', '', d)} thermald"

# recommended extra packages common to all intel machines
MACHINE_EXTRA_RRECOMMENDS_append = " kernel-modules linux-firmware"

# for the early boot time kernel microcode loading support,
# merge the microcode data in the final initrd image.
INITRD_LIVE_prepend = "${@bb.utils.contains('MACHINE_FEATURES', 'intel-ucode', '${DEPLOY_DIR_IMAGE}/microcode.cpio ', '', d)}"

DISK_SIGNATURE_UUID ??= "deadbeef-dead-beef-dead-beefdeadbeef"

EFI_PROVIDER ?= "rmc-boot"
EFI_PROVIDER_x86-x32 = "grub-efi"

# Add general MACHINEOVERRIDE for meta-intel
MACHINEOVERRIDES =. "intel-x86-common:"

# Definition of (more or less) suitable virtual machines.
require conf/machine/include/qemuboot-intel.inc

# Ensure that the extra tools needed by qemu are built when building images
# and tweak machine definition to make the result more usable under qemu.
require conf/machine/include/qemu-intel.inc
```
