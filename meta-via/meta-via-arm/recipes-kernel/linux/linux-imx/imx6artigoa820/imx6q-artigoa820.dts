/*
 * Copyright 2014-2018 VIA Technologies, Inc.
 * Copyright 2012-2015 Freescale Semiconductor, Inc.
 * Copyright 2011 Linaro Ltd.
 *
 * The code contained herein is licensed under the GNU General Public
 * License. You may obtain a copy of the GNU General Public License
 * Version 2 or later at the following locations:
 *
 * http://www.opensource.org/licenses/gpl-license.html
 * http://www.gnu.org/copyleft/gpl.html
 */

/dts-v1/;

#include "imx6q.dtsi"
#include "imx6qdl-artigoa820.dtsi"

/ {
	model = "VIA i.MX6 Dual/Quad ARTiGO A820 Board";
	compatible = "via,imx6q-artigoa820", "fsl,imx6q";
};
