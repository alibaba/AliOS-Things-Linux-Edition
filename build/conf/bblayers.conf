## meta-bsp/meta-intel/conf/machine/intel-corei7-64.conf
```bitbake
#@TYPE: Machine
#@NAME: intel-corei7-64

#@DESCRIPTION: Machine configuration for 64 bit Intel Core i7 CPU (and later) with MMX, SSE, SSE2, SSE3, and SSSE3 instruction set support. Supports a moderately wide range of drivers that should boot and be usable on "typical" hardware.

require conf/machine/include/meta-intel.inc
require conf/machine/include/intel-corei7-64-common.inc
require conf/machine/include/intel-common-pkgarch.inc

MACHINE_FEATURES += "pcbios efi"
MACHINE_FEATURES += "va-impl-intel"
MACHINE_FEATURES += "wifi 3g nfc"
MACHINE_FEATURES += "intel-ucode"

MACHINE_HWCODECS ?= "va-intel gstreamer1.0-vaapi"

MACHINE_EXTRA_RRECOMMENDS += "lms8"

# Enable optional dpdk:
COMPATIBLE_MACHINE_pn-dpdk = "intel-corei7-64"
COMPATIBLE_MACHINE_pn-dpdk-dev-libibverbs = "intel-corei7-64"
DPDK_TARGET_MACHINE ?= "atm"

# Enable optional QAT items:
COMPATIBLE_MACHINE_pn-openssl-qat = "intel-corei7-64"
COMPATIBLE_MACHINE_pn-qat16 = "intel-corei7-64"
COMPATIBLE_MACHINE_pn-zlib-qat = "intel-corei7-64"

XSERVER ?= "${XSERVER_X86_BASE} \
            ${XSERVER_X86_EXT} \
            ${XSERVER_X86_FBDEV} \
            ${XSERVER_X86_I915} \
            ${XSERVER_X86_I965} \
            ${XSERVER_X86_MATROX_MGA} \
            ${XSERVER_X86_MODESETTING} \
            ${XSERVER_X86_VESA} \
            ${XSERVER_X86_ASPEED_AST} \
           "

SYSLINUX_OPTS = "serial 0 115200"
SERIAL_CONSOLES = "115200;ttyS0"
APPEND += "rootwait console=ttyS0,115200 console=tty0"

IMAGE_FSTYPES += "wic"
WKS_FILE ?= "${@bb.utils.contains_any("EFI_PROVIDER", "systemd-boot rmc-boot", "systemd-bootdisk.wks", "mkefidisk.wks", d)}"
do_image_wic[depends] += "gptfdisk-native:do_populate_sysroot mtools-native:do_populate_sysroot dosfstools-native:do_populate_sysroot"
```

## meta-bsp/meta-intel/wic/galileodisk-sd.wks
```
# short-description: Create a Galileo Gen 1/2 disk image (SD card)
# long-description: Creates a partitioned EFI disk image for Intel Galileo Gen 1/2
# boards that the user can directly dd to an SD card and boot.

part /boot --source bootimg-efi --sourceparams="loader=systemd-boot" --ondisk mmcblk0 --label msdos --active --align 1024

part / --source rootfs --ondisk mmcblk0 --fstype=ext3 --label platform --align 1024 --use-uuid

bootloader  --timeout=1  --append="rootwait console=ttyS1,115200n8 earlycon=uart8250,mmio32,0x9000b000,115200n8 reboot=efi,warm apic=debug rw LABEL=boot debugshell=5"
```

## meta-bsp/meta-mont/conf/layer.conf
```bitbake
# We have a conf and classes directory, add to BBPATH
BBPATH .= ":${LAYERDIR}"

# We have a recipes-* directories, add to BBFILES
BBFILES += "${LAYERDIR}/recipes-*/*/*.bb \
	${LAYERDIR}/recipes-*/*/*.bbappend"

BBFILE_COLLECTIONS += "mont"
BBFILE_PATTERN_mont = "^${LAYERDIR}/"
BBFILE_PRIORITY_mont = "10"
```

## meta-bsp/meta-mont/conf/machine/ci40.conf
```bitbake
#@TYPE: Machine
#@NAME: ci40
#@DESCRIPTION: Imagination Technologies Creator Ci40 platform
#For more detail check out http://creatordev.io/ci40-iot-hub

require conf/machine/include/tune-mips32r2.inc

DEFAULTTUNE = "mips32r2el"
MACHINE_FEATURES = "serial"
SERIAL_CONSOLES = "115200;ttyS1"
IMAGE_FSTYPES ?= "tar.gz"

PREFERRED_PROVIDER_virtual/kernel = "linux-yocto-ci40"
KERNEL_IMAGETYPE = "uImage.bin"

PREFERRED_PROVIDER_u-boot = "u-boot_ci40.bb"

IMAGE_BOOT_FILES = "u-boot.img"

# Tune the ccargs for the interAptiv on the Ci40
TUNE_CCARGS_remove = "-march=mips32r2"
TUNE_CCARGS .= " -march=interaptiv"

# Add extra packages
IMAGE_INSTALL += " iw"
IMAGE_INSTALL += " wireless-tools"
IMAGE_INSTALL += "  uccp420wlan"

# The wireless driver is built as a module
MACHINE_EXTRA_RRECOMMENDS = " kernel-modules"

# Disable gobject-introspection
MACHINE_FEATURES_BACKFILL_CONSIDERED = "qemu-usermode"
```

## meta-bsp/meta-mont/conf/machine/qemumips32r2el-nf.conf
```bitbake
#@TYPE: Machine
#@NAME: qemumips32r2el-nf
#@DESCRIPTION: MIPS 32r2, Little Endian, Soft Float

require conf/machine/include/qemu.inc
require conf/machine/include/qemuboot-mips.inc
require conf/machine/include/tune-mips32r2.inc
require mips-common.inc

DEFAULTTUNE = "mips32r2el-nf"
```

## meta-bsp/meta-mont/conf/machine/qemumips64r2-nf-n32.conf
```bitbake
#@TYPE: Machine
#@NAME: qemumips64r2-nf-n32
#@DESCRIPTION: MIPS 64r2, Big Endian, Soft Float, n32

require conf/machine/include/qemu.inc
require conf/machine/include/qemuboot-mips.inc
require conf/machine/include/tune-mips64r2.inc
require mips-common.inc

DEFAULTTUNE = "mips64r2-nf-n32"

# runqemu extra options
QB_CPU = "-cpu MIPS64R2-generic"
```

## meta-bsp/meta-mont/conf/machine/qemumips64r2.conf
```bitbake
#@TYPE: Machine
#@NAME: qemumips64r2
#@DESCRIPTION: MIPS 64r2, Big Endian, Hard Float, n64

require conf/machine/include/qemu.inc
require conf/machine/include/qemuboot-mips.inc
require conf/machine/include/tune-mips64r2.inc
require mips-common.inc

DEFAULTTUNE = "mips64r2"

# runqemu extra options
QB_CPU = "-cpu MIPS64R2-generic"
```

## meta-bsp/meta-mont/conf/machine/qemumips64r6-nf.conf
```bitbake
#@TYPE: Machine
#@NAME: qemumips64r6-nf
#@DESCRIPTION: MIPS 64r6, Big Endian, Soft Float

require conf/machine/include/qemu.inc
require conf/machine/include/qemuboot-mips.inc
require conf/machine/include/tune-mips64r6.inc
require mips-common.inc

DEFAULTTUNE = "mipsisa64r6-nf"

# runqemu extra options
QB_CPU = "-cpu I6400"
QB_SYSTEM_NAME = "qemu-system-mips64"
```

## meta-bsp/meta-mont/conf/machine/qemumips64r6el-nf.conf
```bitbake
#@TYPE: Machine
#@NAME: qemumips64r6el-nf
#@DESCRIPTION: MIPS 64r6, Little Endian, Soft Float

require conf/machine/include/qemu.inc
require conf/machine/include/qemuboot-mips.inc
require conf/machine/include/tune-mips64r6.inc
require mips-common.inc

DEFAULTTUNE = "mipsisa64r6el-nf"

# runqemu extra options
QB_CPU = "-cpu I6400"
QB_SYSTEM_NAME = "qemu-system-mips64el"
```

## meta-bsp/meta-mont/conf/machine/sead3-32r6el.conf
```bitbake
#@TYPE: Machine
#@NAME: sead3-32r6el
#@DESCRIPTION: SEAD3 Development Platform. MIPS 32r6, Little Endian, Hard float

require conf/machine/include/tune-mips32r6.inc
require mips-common.inc

DEFAULTTUNE = "mipsisa32r6el"
KERNEL_IMAGETYPE = "uImage"
```

## meta-bsp/meta-mont/conf/machine/utm8el.conf
```bitbake
#@TYPE: Machine
#@NAME: utm8el
#@DESCRIPTION: Rhino Labs UTM8 based around Cavium CN7130 SoC. MIPS64r2, Little Endian, Hard Float, n64

require conf/machine/include/tune-mips64r2.inc
require mips-common.inc

DEFAULTTUNE = "mips64r2el"
```

## meta-bsp/meta-mont/conf/machine/xilfpga.conf
```bitbake
#@TYPE: Machine
#@NAME: xilfpga
#@DESCRIPTION: MIPSfpga  Imagination University Program

require conf/machine/include/tune-mips32r2.inc

DEFAULTTUNE = "mips32r2el-nf"
MACHINE_FEATURES = "serial"
SERIAL_CONSOLES = "115200;ttyS0"
IMAGE_FSTYPES ?= "tar.gz"

PREFERRED_PROVIDER_virtual/kernel = "linux-yocto"
#KERNEL_DEFCONFIG_xilfpga = "xilfpga_defconfig"
KERNEL_IMAGETYPE = "vmlinux"
```
