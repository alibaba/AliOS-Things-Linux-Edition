## build/conf/bblayers.conf
```bitbake
# POKY_BBLAYERS_CONF_VERSION is increased each time build/conf/bblayers.conf
# changes incompatibly
POKY_BBLAYERS_CONF_VERSION = "2"

BBPATH = "${TOPDIR}"
BBFILES ?= ""

BBLAYERS ?= " \
  ${TOPDIR}/../meta-yp/meta \
  ${TOPDIR}/../meta-yp/meta-openembedded/meta-oe \
  ${TOPDIR}/../meta-yp/meta-openembedded/meta-perl \
  ${TOPDIR}/../meta-core/meta-base \
  ${TOPDIR}/../meta-core/meta-security/meta-accounts \
  ${TOPDIR}/../meta-core/meta-security/meta \
  ${TOPDIR}/../meta-core/meta-security/meta-signing-key \
  ${TOPDIR}/../meta-core/meta-security/meta-tpm2 \
  ${TOPDIR}/../meta-core/meta-security/meta-efi-secure-boot \
  ${TOPDIR}/../meta-core/meta-security/meta-encrypted-storage \
  ${TOPDIR}/../meta-bsp/meta-intel \
  ${TOPDIR}/../meta-external \
  "
```

## conf/layer.conf
```bitbake
# We have a conf and classes directory, add to BBPATH
BBPATH .= ":${LAYERDIR}"

# We have recipes-* directories, add to BBFILES
BBFILES += "${LAYERDIR}/recipes-*/*.bb \
            ${LAYERDIR}/recipes-*/*/*.bb \
            ${LAYERDIR}/recipes-*/*/*.bbappend"

BBFILE_COLLECTIONS   += "linkx"
BBFILE_PATTERN_linkx  = "^${LAYERDIR}/"
BBFILE_PRIORITY_linkx = "9"
```

## meta-application/meta-demo/conf/layer.conf
```bitbake
# We have a conf and classes directory, add to BBPATH
BBPATH .= ":${LAYERDIR}"

# We have recipes-* directories, add to BBFILES
BBFILES += "${LAYERDIR}/recipes-*/*/*.bb \
            ${LAYERDIR}/recipes-*/*/*.bbappend"

BBFILE_COLLECTIONS  += "demo"
BBFILE_PATTERN_demo  = "^${LAYERDIR}/"
BBFILE_PRIORITY_demo = "9"

LAYERDEPENDS_demo = "core"
```

## meta-base/conf/distro/alios-tiny.conf
```bitbake
# The policies defined are intended to meet the following goals:
# o Serial consoles only (no framebuffer or VGA console)
# o Basic support for IPV4 networking
# o Single user ash shell
# o Static images (no support for adding packages or libraries later)
# o Read-only or RAMFS root filesystem
# o Combined Linux kernel + rootfs in under 4MB
# o Allow the user to select from eglibc, uclibc or bionic with the TCLIBC variable
#
# This is currently a partial definition, the following tasks remain:
# [ ] Integrate linux-yocto-tiny ktype into linux-yocto
# [ ] Define linux-yocto-tiny configs for all supported BSPs
# [ ] Drop ldconfig from the installation
# [ ] Modify the runqemu scripts to work with ext2 parameter:
#     runqemu qemux86 qemuparams="-nographic" bootparams="console=ttyS0,115200 root=0800"
# [ ] Modify busybox to allow for DISTRO_FEATURES-like confiruration

require conf/distro/alios.conf

DISTRO = "alios-tiny"
DISTROOVERRIDES = "alios:alios-tiny"

TCLIBC ?= "musl"

PREFERRED_PROVIDER_virtual/kernel = "linux-yocto-tiny"
PREFERRED_VERSION_linux-yocto-tiny ?= "4.9%"
# For now, linux-yocto-tiny does not support aarch64
PREFERRED_PROVIDER_virtual/kernel_aarch64 = "linux-yocto"
PREFERRED_VERSION_linux-yocto_aarch64 ?= "4.9%"

INITRAMFS_MAXSIZE ??= "256000"

# We can use packagegroup-core-boot, but in the future we may need a new packagegroup-core-tiny
#POKY_DEFAULT_EXTRA_RDEPENDS += "packagegroup-core-boot"

# Drop kernel-module-af-packet from RRECOMMENDS
POKY_DEFAULT_EXTRA_RRECOMMENDS = ""

# Disable wide char support.
ENABLE_WIDEC = "false"
ENABLE_WIDEC_class-native = "true"

# Drop native language support.
USE_NLS="no"

# Comment out any of the lines below to disable them in the build
# DISTRO_FEATURES options:
# alsa bluetooth ext2 irda pcmcia usbgadget usbhost wifi nfs zeroconf pci
DISTRO_FEATURES_TINY = "pci"
DISTRO_FEATURES_NET = "ipv4 ipv6"
DISTRO_FEATURES_USB = "usbhost"
#DISTRO_FEATURES_USBGADGET = "usbgadget"
#DISTRO_FEATURES_WIFI = "wifi"

DISTRO_FEATURES = "${DISTRO_FEATURES_TINY} \
                   ${DISTRO_FEATURES_NET} \
                   ${DISTRO_FEATURES_USB} \
                   ${DISTRO_FEATURES_USBGADGET} \
                   ${DISTRO_FEATURES_WIFI} \
                  "

# Enable LFS - see bug YOCTO #5865
DISTRO_FEATURES_append_libc-uclibc = " largefile"
DISTRO_FEATURES_append_libc-musl = " largefile"

DISTRO_FEATURES_class-native = "${DISTRO_FEATURES_DEFAULT} ${DISTRO_FEATURES_LIBC} ${POKY_DEFAULT_DISTRO_FEATURES}"
DISTRO_FEATURES_class-nativesdk = "${DISTRO_FEATURES_DEFAULT} ${DISTRO_FEATURES_LIBC} ${POKY_DEFAULT_DISTRO_FEATURES}"

# enable mdev/busybox for init
VIRTUAL-RUNTIME_dev_manager = "busybox-mdev"
#VIRTUAL-RUNTIME_login_manager = "busybox"
VIRTUAL-RUNTIME_init_manager = "busybox"
VIRTUAL-RUNTIME_initscripts = "initscripts"
VIRTUAL-RUNTIME_keymaps = "keymaps"
DISTRO_FEATURES_BACKFILL_CONSIDERED += "sysvinit"

# FIXME: Consider adding "modules" to MACHINE_FEATURES and using that in
# packagegroup-core-base to select modutils-initscripts or not.  Similar with "net" and
# netbase.

# By default we only support initramfs. We don't build live as that
# pulls in a lot of dependencies for the live image and the installer, like
# udev, grub, etc.  These pull in gettext, which fails to build with wide
# character support.
IMAGE_FSTYPES = "cpio.gz"
IMAGE_FSTYPES_raspberrypi3-64  = "tar.bz2 ext4 rpi-sdimg"

QB_DEFAULT_FSTYPE = "${IMAGE_FSTYPES}"

# Drop v86d from qemu dependency list (we support serial)
# Drop grub from meta-intel BSPs
# FIXME: A different mechanism is needed here. We could define -tiny
#        variants of all compatible machines, but that leads to a lot
#        more machine configs to maintain long term.
MACHINE_ESSENTIAL_EXTRA_RDEPENDS = ""

# Disable python usage in opkg-utils since it won't build with tiny config
PACKAGECONFIG_remove_pn-opkg-utils = "python"
```

## meta-base/conf/distro/alios.conf
```bitbake
require conf/distro/include/alios.inc

# kernel base
PREFERRED_PROVIDER_virtual/kernel = "linux-yocto"
PREFERRED_VERSION_linux-yocto = "4.9%"
LINUXLIBCVERSION = "4.9%"

# GCC toolchain
GCCVERSION = "6.3%"
GLIBCVERSION = "2.24%"
```

## meta-base/conf/distro/include/AliOS.inc
```bitbake
DISTRO = "AliOS"
DISTRO_NAME = "AliOS Things"
DISTRO_CODENAME = "M2"
DISTRO_VERSION = "1.1.0"
HOSTOS_VERSION = "${DISTRO_VERSION}"

MAINTAINER = "iot <iot@alibaba-inc.com>"

TARGET_VENDOR = "-AliOS"

SDK_VENDOR = "-aliossdk"
SDK_VERSION := "${@'${DISTRO_VERSION}'.replace('snapshot-${DATE}','snapshot')}"

# Override these in poky based distros
POKY_DEFAULT_DISTRO_FEATURES = "largefile opengl ptest multiarch wayland vulkan"
POKY_DEFAULT_EXTRA_RDEPENDS = "packagegroup-core-boot"
POKY_DEFAULT_EXTRA_RRECOMMENDS = "kernel-module-af-packet"

DISTRO_FEATURES ?= "${DISTRO_FEATURES_DEFAULT} ${DISTRO_FEATURES_LIBC} ${POKY_DEFAULT_DISTRO_FEATURES}"

PREFERRED_VERSION_linux-yocto ?= "4.9%"

SDK_NAME = "${DISTRO}-${TCLIBC}-${SDK_ARCH}-${IMAGE_BASENAME}-${TUNE_PKGARCH}"
SDKPATH = "/opt/${DISTRO}/${SDK_VERSION}"

# This hooks into packagegroup-base, so it won't do anything if your images doesn't include packagegroup-base.
DISTRO_EXTRA_RDEPENDS += " ${POKY_DEFAULT_EXTRA_RDEPENDS}"

# This also hooks into packagegroup-base, but isn't mandatory.
DISTRO_EXTRA_RRECOMMENDS += " ${POKY_DEFAULT_EXTRA_RRECOMMENDS}"

POKYQEMUDEPS = "${@bb.utils.contains("INCOMPATIBLE_LICENSE", "GPL-3.0", "", "packagegroup-core-device-devel",d)}"
DISTRO_EXTRA_RDEPENDS_append_qemuarm = " ${POKYQEMUDEPS}"
DISTRO_EXTRA_RDEPENDS_append_qemuarm64 = " ${POKYQEMUDEPS}"
DISTRO_EXTRA_RDEPENDS_append_qemumips = " ${POKYQEMUDEPS}"
DISTRO_EXTRA_RDEPENDS_append_qemuppc = " ${POKYQEMUDEPS}"
DISTRO_EXTRA_RDEPENDS_append_qemux86 = " ${POKYQEMUDEPS}"
DISTRO_EXTRA_RDEPENDS_append_qemux86-64 = " ${POKYQEMUDEPS}"

TCLIBCAPPEND = ""

QEMU_TARGETS ?= "arm aarch64 i386 mips mipsel mips64 mips64el nios2 ppc x86_64"

PREMIRRORS ??= "\
bzr://.*/.*   http://downloads.yoctoproject.org/mirror/sources/ \n \
cvs://.*/.*   http://downloads.yoctoproject.org/mirror/sources/ \n \
git://.*/.*   http://downloads.yoctoproject.org/mirror/sources/ \n \
gitsm://.*/.* http://downloads.yoctoproject.org/mirror/sources/ \n \
hg://.*/.*    http://downloads.yoctoproject.org/mirror/sources/ \n \
osc://.*/.*   http://downloads.yoctoproject.org/mirror/sources/ \n \
p4://.*/.*    http://downloads.yoctoproject.org/mirror/sources/ \n \
svn://.*/.*   http://downloads.yoctoproject.org/mirror/sources/ \n"

MIRRORS =+ "\
ftp://.*/.*      http://downloads.yoctoproject.org/mirror/sources/ \n \
http://.*/.*     http://downloads.yoctoproject.org/mirror/sources/ \n \
https://.*/.*    http://downloads.yoctoproject.org/mirror/sources/ \n"

SANITY_TESTED_DISTROS ?= " \
            poky-2.4 \n \
            ubuntu-16.04 \n \
            ubuntu-16.10 \n \
            "
#
# OELAYOUT_ABI allows us to notify users when the format of TMPDIR changes in
# an incompatible way. Such changes should usually be detailed in the commit
# that breaks the format and have been previously discussed on the mailing list
# with general agreement from the core team.
#
OELAYOUT_ABI = "12"

# QA check settings - a little stricter than the OE-Core defaults
WARN_TO_ERROR_QA = "already-stripped compile-host-path install-host-path \
                    installed-vs-shipped ldflags pn-overrides rpaths staticdev \
                    useless-rpaths"
WARN_QA_remove = "${WARN_TO_ERROR_QA}"
ERROR_QA_append = " ${WARN_TO_ERROR_QA}"

require conf/distro/include/no-static-libs.inc
require conf/distro/include/yocto-uninative.inc
INHERIT += "uninative"
```

## meta-base/conf/distro/include/alios.inc
```bitbake
DISTRO = "alios"
DISTRO_NAME = "AliOS Things Linux Edition"
DISTRO_CODENAME = "M3"
DISTRO_VERSION = "1.3.0"
HOSTOS_VERSION = "${DISTRO_VERSION}"

MAINTAINER = "iot <iot@alibaba-inc.com>"

TARGET_VENDOR = "-alios"

SDK_VENDOR = "-aliossdk"
SDK_VERSION := "${@'${DISTRO_VERSION}'.replace('snapshot-${DATE}','snapshot')}"

DISTRO_FEATURES ?= "${DISTRO_FEATURES_DEFAULT} ${DISTRO_FEATURES_LIBC}"

PREFERRED_VERSION_linux-yocto ?= "4.9%"

SDK_NAME = "${DISTRO}-${TCLIBC}-${SDK_ARCH}-${IMAGE_BASENAME}-${TUNE_PKGARCH}"
SDKPATH = "/opt/${DISTRO}/${SDK_VERSION}"

TCLIBCAPPEND = ""

QEMU_TARGETS ?= "arm aarch64 i386 mips mipsel mips64 mips64el nios2 ppc x86_64"

PREMIRRORS ??= "\
bzr://.*/.*   http://downloads.yoctoproject.org/mirror/sources/ \n \
cvs://.*/.*   http://downloads.yoctoproject.org/mirror/sources/ \n \
git://.*/.*   http://downloads.yoctoproject.org/mirror/sources/ \n \
gitsm://.*/.* http://downloads.yoctoproject.org/mirror/sources/ \n \
hg://.*/.*    http://downloads.yoctoproject.org/mirror/sources/ \n \
osc://.*/.*   http://downloads.yoctoproject.org/mirror/sources/ \n \
p4://.*/.*    http://downloads.yoctoproject.org/mirror/sources/ \n \
svn://.*/.*   http://downloads.yoctoproject.org/mirror/sources/ \n"

MIRRORS =+ "\
ftp://.*/.*      http://downloads.yoctoproject.org/mirror/sources/ \n \
http://.*/.*     http://downloads.yoctoproject.org/mirror/sources/ \n \
https://.*/.*    http://downloads.yoctoproject.org/mirror/sources/ \n"

SANITY_TESTED_DISTROS ?= " \
            poky-2.4 \n \
            ubuntu-16.04 \n \
            ubuntu-16.10 \n \
            "
#
# OELAYOUT_ABI allows us to notify users when the format of TMPDIR changes in
# an incompatible way. Such changes should usually be detailed in the commit
# that breaks the format and have been previously discussed on the mailing list
# with general agreement from the core team.
#
OELAYOUT_ABI = "12"

# QA check settings - a little stricter than the OE-Core defaults
WARN_TO_ERROR_QA = "already-stripped compile-host-path install-host-path \
                    installed-vs-shipped ldflags pn-overrides rpaths staticdev \
                    useless-rpaths"
WARN_QA_remove = "${WARN_TO_ERROR_QA}"
ERROR_QA_append = " ${WARN_TO_ERROR_QA}"

# Set AliOS Things splash image
SPLASH = "psplash-alios-things"

# Add welcome message in /etc/issue for /sbin/agetty
# create from http://patorjk.com/software/taag/
add_welcom_message_for_agetty() {
echo "       █████╗ ██╗     ██╗ ██████╗ ███████╗     " >> ${IMAGE_ROOTFS}/etc/issue
echo "      ██╔══██╗██║     ██║██╔═══██╗██╔════╝     " >> ${IMAGE_ROOTFS}/etc/issue
echo "      ███████║██║     ██║██║   ██║███████╗     " >> ${IMAGE_ROOTFS}/etc/issue
echo "      ██╔══██║██║     ██║██║   ██║╚════██║     " >> ${IMAGE_ROOTFS}/etc/issue
echo "      ██║  ██║███████╗██║╚██████╔╝███████║     " >> ${IMAGE_ROOTFS}/etc/issue
echo "      ╚═╝  ╚═╝╚══════╝╚═╝ ╚═════╝ ╚══════╝     " >> ${IMAGE_ROOTFS}/etc/issue
echo "████████╗██╗  ██╗██╗███╗   ██╗ ██████╗ ███████╗" >> ${IMAGE_ROOTFS}/etc/issue
echo "╚══██╔══╝██║  ██║██║████╗  ██║██╔════╝ ██╔════╝" >> ${IMAGE_ROOTFS}/etc/issue
echo "   ██║   ███████║██║██╔██╗ ██║██║  ███╗███████╗" >> ${IMAGE_ROOTFS}/etc/issue
echo "   ██║   ██╔══██║██║██║╚██╗██║██║   ██║╚════██║" >> ${IMAGE_ROOTFS}/etc/issue
echo "   ██║   ██║  ██║██║██║ ╚████║╚██████╔╝███████║" >> ${IMAGE_ROOTFS}/etc/issue
echo "   ╚═╝   ╚═╝  ╚═╝╚═╝╚═╝  ╚═══╝ ╚═════╝ ╚══════╝" >> ${IMAGE_ROOTFS}/etc/issue
}
ROOTFS_POSTPROCESS_COMMAND += "add_welcom_message_for_agetty; "


require conf/distro/include/no-static-libs.inc
require conf/distro/include/yocto-uninative.inc
INHERIT += "uninative"
```

## meta-base/conf/layer.conf
```bitbake
# We have a conf and classes directory, add to BBPATH
BBPATH .= ":${LAYERDIR}"

# We have recipes-* directories, add to BBFILES
BBFILES += "${LAYERDIR}/recipes-*/*.bb \
            ${LAYERDIR}/recipes-*/*.bbappend \
            ${LAYERDIR}/recipes-*/*/*.bb \
            ${LAYERDIR}/recipes-*/*/*.bbappend"

BBFILE_COLLECTIONS  += "base"
BBFILE_PATTERN_base  = "^${LAYERDIR}/"
BBFILE_PRIORITY_base = "9"

LAYERDEPENDS_base = "core openembedded-layer networking-layer"
```

## meta-bsp/meta-intel/conf/machine/include/intel-common-pkgarch.inc
```bitbake
INTEL_COMMON_PACKAGE_ARCH ?= "${TUNE_PKGARCH}-intel-common"
PACKAGE_ARCH_pn-linux-intel = "${INTEL_COMMON_PACKAGE_ARCH}"
PACKAGE_ARCH_pn-linux-intel-rt = "${INTEL_COMMON_PACKAGE_ARCH}"
PACKAGE_ARCH_pn-linux-intel-tiny = "${INTEL_COMMON_PACKAGE_ARCH}"
PACKAGE_ARCH_pn-linux-intel-dev = "${INTEL_COMMON_PACKAGE_ARCH}"
PACKAGE_ARCH_pn-linux-yocto = "${INTEL_COMMON_PACKAGE_ARCH}"
PACKAGE_ARCH_pn-linux-yocto-rt = "${INTEL_COMMON_PACKAGE_ARCH}"
PACKAGE_ARCH_pn-linux-yocto-tiny = "${INTEL_COMMON_PACKAGE_ARCH}"
PACKAGE_ARCH_pn-linux-yocto-dev = "${INTEL_COMMON_PACKAGE_ARCH}"
PACKAGE_ARCH_pn-intel-microcode = "${INTEL_COMMON_PACKAGE_ARCH}"
PACKAGE_ARCH_pn-backport-iwlwifi = "${INTEL_COMMON_PACKAGE_ARCH}"
PACKAGE_ARCH_pn-ixgbe = "${INTEL_COMMON_PACKAGE_ARCH}"
PACKAGE_ARCH_pn-ixgbevf = "${INTEL_COMMON_PACKAGE_ARCH}"
PACKAGE_EXTRA_ARCHS_append += "${INTEL_COMMON_PACKAGE_ARCH}"
MACHINEOVERRIDES =. "${INTEL_COMMON_PACKAGE_ARCH}:"
```

## meta-bsp/meta-intel/conf/machine/include/intel-core2-32-common.inc
```bitbake
#
# Common configuration for all MACHINEs of the intel-core2 type
#

DEFAULTTUNE ?= "core2-32"
require conf/machine/include/tune-core2.inc
require conf/machine/include/x86-base.inc
```

## meta-bsp/meta-intel/conf/machine/include/intel-corei7-64-common.inc
```bitbake
#
# Common configuration for all MACHINES of the intel-corei7-64 type
#

DEFAULTTUNE ?= "corei7-64"
require conf/machine/include/tune-corei7.inc
require conf/machine/include/x86-base.inc
```

## meta-bsp/meta-intel/conf/machine/include/qemu-intel.inc
```bitbake
# Similar to meta/conf/machine/include/qemu.inc but influences the
# distro content (in particular the kernel) less than qemu.inc.

# Ensure that qemu gets built when building images.
EXTRA_IMAGEDEPENDS += "qemu-native qemu-helper-native"

# Build ovmf firmware for uefi support in qemu.
EXTRA_IMAGEDEPENDS += "ovmf"

# runqemu uses virtio, so we have to enable the corresponding
# kernel drivers.
KERNEL_FEATURES_INTEL_COMMON += "cfg/virtio.scc"

# Other useful extensions which are not enabled by default:
# rng-tools to take advantage of qemu's virtio-rng-pci device.
# MACHINE_EXTRA_RRECOMMENDS += "rng-tools"

# Creates the necessary .qemuboot.conf file for each image.
IMAGE_CLASSES += "qemuboot"
```
